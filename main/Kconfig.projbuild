## main/Kconfig.projbuild
```kconfig
menu "Access controller configuration"

    config WIFI_SSID
        string "WiFi SSID"
        default "myssid"
        help
            SSID (network name) to connect to

    config WIFI_PASSWORD
        string "WiFi Password"
        default "mypassword"
        help
            WiFi password to use.

    config MIN_RECONNECT_INTERVAL
        int "Minimum reconnect interval in seconds"
        default 5
        help
            Minimum reconnect interval

    config MAX_RECONNECT_INTERVAL
        int "Maximum reconnect interval"
        default 60
        help
            Maximum reconnect interval

    config BASE_URL
        string "Base access control URL"
        default "http://example.com"
        help
            Base access control server URL without trailing slash

    config NFC_TASK_STACK_SIZE
        int "NFC task stack size"
        default 2048
        help
            Stack size of the NFC task
    
    config SYSLOG_IP
        string "Syslog IP Address"
        default "10.0.0.1"
        help
            The IP address of a syslog server for logging.

    config SYSLOG_PORT
        int "Syslog Port"
        default 514
        help
            The UDP port number for syslog

    config MQTT_SN_IP
        string "MQTT SN IP Address"
        default "10.0.0.1"
        help
            The IP address of a mqtt-sn server.

    config MQTT_SN_PORT
        int "MQTT SN Port"
        default 514
        help
            The UDP port number for mqtt-sn

endmenu
```
